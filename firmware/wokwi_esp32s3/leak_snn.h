// Event-driven LeakSNN inference: a plain C++ port of gasleak/models.py::LeakSNN (no dependencies,
// runs on ESP32-S3 and on a PC).  Network: 32 spike inputs -> LIF(64) -> LIF(64) -> leaky readout.
//
// Neuron equations are the ones of snnTorch Leaky (reset by subtraction, delayed reset):
//     reset = mem_prev > thr;   mem = beta * mem_prev + I - reset * thr;   spike = mem > thr
// readout (reset "none"):  m3 = beta3 * m3 + I3;   logit = m3 + bias_out
//
// Event-driven: a fully connected layer only adds the weight columns of inputs that spiked in this
// time step (one accumulate per synaptic event), instead of a full matrix-vector product.
// step_dense() computes the same thing frame-based (all weights every step) for comparison.
#pragma once
#include <stdint.h>
#include <string.h>
#include "snn_weights.h"   // generated by export_firmware.py

struct SnnStats {
  uint32_t steps = 0, in_events = 0, s1_spikes = 0, s2_spikes = 0, synops = 0;
};

class LeakSNN {
 public:
  void reset() {
    memset(m1_, 0, sizeof m1_); memset(m2_, 0, sizeof m2_); m3_ = 0.f; stats = SnnStats();
  }

  // in: indices of the input channels that spiked at this step (n of them) -> logit of "leak present"
  float step(const uint8_t* in, int n) {
    float cur[SNN_N_HID];
    uint8_t a1[SNN_N_HID], a2[SNN_N_HID];
    memcpy(cur, SNN_B1, sizeof cur);
    for (int k = 0; k < n; k++) accumulate(cur, SNN_W1T[in[k]]);
    int n1 = lif(m1_, cur, SNN_BETA1, SNN_THR1, a1);
    memcpy(cur, SNN_B2, sizeof cur);
    for (int k = 0; k < n1; k++) accumulate(cur, SNN_W2T[a1[k]]);
    int n2 = lif(m2_, cur, SNN_BETA2, SNN_THR2, a2);
    float c3 = SNN_B3;
    for (int k = 0; k < n2; k++) c3 += SNN_W3[a2[k]];
    m3_ = SNN_BETA3 * m3_ + c3;
    stats.steps++; stats.in_events += n; stats.s1_spikes += n1; stats.s2_spikes += n2;
    stats.synops += (uint32_t)(n + n1) * SNN_N_HID + n2;
    return m3_ + SNN_BIAS_OUT;
  }

  // frame-based reference: every weight is used every step (multiply by 0/1 inputs)
  float step_dense(const uint8_t* in, int n) {
    float x[SNN_N_IN] = {0}, s1[SNN_N_HID], s2[SNN_N_HID], cur[SNN_N_HID];
    uint8_t a1[SNN_N_HID], a2[SNN_N_HID];
    for (int k = 0; k < n; k++) x[in[k]] = 1.f;
    matvec(cur, SNN_B1, &SNN_W1T[0][0], x, SNN_N_IN);
    int n1 = lif(m1_, cur, SNN_BETA1, SNN_THR1, a1);
    spikes_to_vec(s1, a1, n1);
    matvec(cur, SNN_B2, &SNN_W2T[0][0], s1, SNN_N_HID);
    int n2 = lif(m2_, cur, SNN_BETA2, SNN_THR2, a2);
    spikes_to_vec(s2, a2, n2);
    float c3 = SNN_B3;
    for (int j = 0; j < SNN_N_HID; j++) c3 += SNN_W3[j] * s2[j];
    m3_ = SNN_BETA3 * m3_ + c3;
    stats.steps++;
    return m3_ + SNN_BIAS_OUT;
  }

  SnnStats stats;

 private:
  static void accumulate(float* cur, const float* w) {
    for (int j = 0; j < SNN_N_HID; j++) cur[j] += w[j];
  }
  static void matvec(float* cur, const float* b, const float* wt, const float* x, int n_in) {
    memcpy(cur, b, SNN_N_HID * sizeof(float));
    for (int i = 0; i < n_in; i++)
      for (int j = 0; j < SNN_N_HID; j++) cur[j] += wt[i * SNN_N_HID + j] * x[i];
  }
  static void spikes_to_vec(float* s, const uint8_t* a, int n) {
    memset(s, 0, SNN_N_HID * sizeof(float));
    for (int k = 0; k < n; k++) s[a[k]] = 1.f;
  }
  static int lif(float* m, const float* cur, float beta, float thr, uint8_t* active) {
    int n = 0;
    for (int j = 0; j < SNN_N_HID; j++) {
      float r = m[j] > thr ? thr : 0.f;
      m[j] = beta * m[j] + cur[j] - r;
      if (m[j] > thr) active[n++] = (uint8_t)j;
    }
    return n;
  }
  float m1_[SNN_N_HID], m2_[SNN_N_HID], m3_ = 0.f;
};

// Alarm logic of gasleak/metrics.py: alarm when the logit stays above SNN_TAU for SNN_K consecutive
// steps, ignoring the first SNN_WARMUP steps (the encoder is still learning the noise floor).
class LeakDetector {
 public:
  void reset() { snn.reset(); t_ = 0; run_ = 0; alarm_t = -1; }
  bool step(const uint8_t* in, int n, bool dense = false) {
    last_logit = dense ? snn.step_dense(in, n) : snn.step(in, n);
    if (t_ >= SNN_WARMUP) run_ = last_logit > SNN_TAU ? run_ + 1 : 0;
    bool alarm = run_ >= SNN_K;
    if (alarm && alarm_t < 0) alarm_t = t_;
    t_++;
    return alarm;
  }
  LeakSNN snn;
  int alarm_t = -1;          // first alarm step (ms), -1 = none
  float last_logit = 0.f;

 private:
  int t_ = 0, run_ = 0;
};
